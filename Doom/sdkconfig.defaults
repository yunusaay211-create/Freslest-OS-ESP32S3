## Doom/sdkconfig.defaults
```kconfig
CONFIG_IDF_TARGET="esp32s3"
CONFIG_ESPTOOLPY_FLASHSIZE_16MB=y
CONFIG_ESPTOOLPY_FLASHMODE_DIO=y
CONFIG_ESPTOOLPY_FLASHFREQ_80M=y
CONFIG_PARTITION_TABLE_CUSTOM=y
CONFIG_PARTITION_TABLE_CUSTOM_FILENAME="partitions.csv"
CONFIG_SPIRAM=y
CONFIG_SPIRAM_MODE_OCT=y
CONFIG_SPIRAM_SPEED_80M=y
CONFIG_SPIRAM_BOOT_INIT=y
CONFIG_SPIRAM_USE_MALLOC=y
CONFIG_SPIRAM_MALLOC_ALWAYSINTERNAL=4096
CONFIG_SPIRAM_MALLOC_RESERVE_INTERNAL=65536
CONFIG_ESP_DEFAULT_CPU_FREQ_MHZ_240=y
CONFIG_FREERTOS_HZ=1000
CONFIG_ESP_MAIN_TASK_STACK_SIZE=8192
# CONFIG_COMPILER_OPTIMIZATION_PERF is not set
CONFIG_ESP_TASK_WDT_TIMEOUT_S=15

CONFIG_NEWLIB_TIME_SYSCALL_USE_RTC_HRT=y

CONFIG_ESP_CONSOLE_SECONDARY_NONE=y
CONFIG_FATFS_LFN_HEAP=y
CONFIG_FATFS_MAX_LFN=128

CONFIG_BOOTLOADER_APP_ROLLBACK_ENABLE=y

CONFIG_ESP_TASK_WDT_PANIC=y

CONFIG_USB_HOST_HUBS_SUPPORTED=y

# CONFIG_USB_HOST_HUB_MULTI_LEVEL is not set
CONFIG_USB_HOST_CONTROL_TRANSFER_MAX_SIZE=1024

CONFIG_COMPILER_OPTIMIZATION_SIZE=y

CONFIG_LOG_DEFAULT_LEVEL_WARN=y
CONFIG_LOG_MAXIMUM_EQUALS_DEFAULT=y

# CONFIG_LOG_DEFAULT_LEVEL_ERROR is not set

CONFIG_COMPILER_OPTIMIZATION_ASSERTIONS_SILENT=y

# CONFIG_LCD_RGB_RESTART_IN_VSYNC is not set

CONFIG_SPIRAM_XIP_FROM_PSRAM=y

CONFIG_SPIRAM_FETCH_INSTRUCTIONS=y

CONFIG_SPIRAM_RODATA=y

CONFIG_LCD_RGB_ISR_IRAM_SAFE=y
```

## OS/main/Kconfig.projbuild
```kconfig
menu "Freslest FreStore"
config FRESLEST_STORE_ORIGIN
    string "HTTPS origin, without a path or trailing slash"
    default ""
    help
        Use a certificate that chains to the ESP-IDF root bundle.
        FreStore can also add a personal HTTPS server from its Server menu.

config FRESLEST_STORE_PUBLIC_KEY
    string "Publisher ECDSA P-256 public key (base64 DER)"
    default ""
    help
        Use the public key printed by FreStore keygen.
        Never include the private key in firmware.
endmenu
```

## OS/sdkconfig.defaults
```kconfig
CONFIG_IDF_TARGET="esp32s3"
CONFIG_ESPTOOLPY_FLASHSIZE_16MB=y
CONFIG_ESPTOOLPY_FLASHMODE_DIO=y
CONFIG_ESPTOOLPY_FLASHFREQ_80M=y
CONFIG_ESP_DEFAULT_CPU_FREQ_MHZ_240=y
CONFIG_SPIRAM=y
CONFIG_SPIRAM_MODE_OCT=y
CONFIG_SPIRAM_SPEED_80M=y
CONFIG_SPIRAM_USE_MALLOC=y
CONFIG_SPIRAM_ALLOW_BSS_SEG_EXTERNAL_MEMORY=y
CONFIG_PARTITION_TABLE_CUSTOM=y
CONFIG_PARTITION_TABLE_CUSTOM_FILENAME="partitions.csv"
CONFIG_FREERTOS_HZ=1000
CONFIG_AUTOSTART_ARDUINO=y
CONFIG_ARDUINO_RUNNING_CORE=1
CONFIG_ARDUINO_LOOP_STACK_SIZE=24576
CONFIG_ARDUINO_VARIANT="esp32s3"
CONFIG_ARDUINO_SELECTIVE_COMPILATION=y
CONFIG_ARDUINO_SELECTIVE_FS=y
CONFIG_ARDUINO_SELECTIVE_LittleFS=y
CONFIG_ARDUINO_SELECTIVE_Preferences=y
CONFIG_ARDUINO_SELECTIVE_SPI=y
CONFIG_ARDUINO_SELECTIVE_Wire=y
CONFIG_ARDUINO_SELECTIVE_Network=y
CONFIG_ARDUINO_SELECTIVE_WiFi=y
CONFIG_ARDUINO_SELECTIVE_WebServer=y
CONFIG_ARDUINO_SELECTIVE_BLE=y
CONFIG_ARDUINO_SELECTIVE_Update=y
CONFIG_BT_ENABLED=y
CONFIG_BT_BLUEDROID_ENABLED=y
CONFIG_BT_BLE_ENABLED=y
CONFIG_COMPILER_OPTIMIZATION_SIZE=y
CONFIG_COMPILER_CXX_EXCEPTIONS=y
CONFIG_NEWLIB_TIME_SYSCALL_USE_RTC_HRT=y
CONFIG_LITTLEFS_PAGE_SIZE=256
CONFIG_LITTLEFS_OBJ_NAME_LEN=64

# CONFIG_ARDUINO_SELECTIVE_ESP_SR is not set

# CONFIG_ARDUINO_SELECTIVE_EEPROM is not set

# CONFIG_ARDUINO_SELECTIVE_Ticker is not set

# CONFIG_ARDUINO_SELECTIVE_Zigbee is not set

CONFIG_ARDUINO_SELECTIVE_SD=y

# CONFIG_ARDUINO_SELECTIVE_SD_MMC is not set

CONFIG_ARDUINO_SELECTIVE_SPIFFS=y

# CONFIG_ARDUINO_SELECTIVE_FFat is not set

# CONFIG_ARDUINO_SELECTIVE_Ethernet is not set

# CONFIG_ARDUINO_SELECTIVE_PPP is not set

CONFIG_ARDUINO_SELECTIVE_ArduinoOTA=y

# CONFIG_ARDUINO_SELECTIVE_AsyncUDP is not set

# CONFIG_ARDUINO_SELECTIVE_DNSServer is not set

# CONFIG_ARDUINO_SELECTIVE_ESPmDNS is not set

# CONFIG_ARDUINO_SELECTIVE_HTTPClient is not set

# CONFIG_ARDUINO_SELECTIVE_Matter is not set

# CONFIG_ARDUINO_SELECTIVE_NetBIOS is not set

# CONFIG_ARDUINO_SELECTIVE_NetworkClientSecure is not set

# CONFIG_ARDUINO_SELECTIVE_WiFiProv is not set

# CONFIG_ARDUINO_SELECTIVE_BluetoothSerial is not set

# CONFIG_ARDUINO_SELECTIVE_SimpleBLE is not set

# CONFIG_ARDUINO_SELECTIVE_RainMaker is not set

# CONFIG_ARDUINO_SELECTIVE_OpenThread is not set

# CONFIG_ARDUINO_SELECTIVE_Insights is not set

CONFIG_BT_BLE_42_FEATURES_SUPPORTED=y
# CONFIG_BT_BLE_50_FEATURES_SUPPORTED is not set

CONFIG_ESP_TIMER_TASK_AFFINITY_CPU0=y

CONFIG_TINYUSB_ENABLED=y

CONFIG_TINYUSB_MSC_ENABLED=y

CONFIG_TINYUSB_MSC_BUFSIZE=4096

CONFIG_TINYUSB_CDC_ENABLED=y
CONFIG_TINYUSB_CDC_RX_BUFSIZE=512
CONFIG_TINYUSB_CDC_TX_BUFSIZE=1024

# CONFIG_TINYUSB_HID_ENABLED is not set

# CONFIG_TINYUSB_MIDI_ENABLED is not set

# CONFIG_TINYUSB_VIDEO_ENABLED is not set

# CONFIG_TINYUSB_DFU_ENABLED is not set

# CONFIG_TINYUSB_DFU_RT_ENABLED is not set

# CONFIG_TINYUSB_VENDOR_ENABLED is not set

# CONFIG_TINYUSB_NCM_ENABLED is not set

CONFIG_FREERTOS_SUPPORT_STATIC_ALLOCATION=y

CONFIG_FREERTOS_USE_AUTHENTIC_INCLUDE_PATHS=y

CONFIG_ESP_CONSOLE_SECONDARY_NONE=y

CONFIG_BOOTLOADER_APP_ROLLBACK_ENABLE=y

CONFIG_ESP_TASK_WDT_PANIC=y

CONFIG_FATFS_LFN_HEAP=y
CONFIG_FATFS_SECTOR_4096=y

CONFIG_USB_HOST_HUBS_SUPPORTED=y

# CONFIG_USB_HOST_HUB_MULTI_LEVEL is not set
CONFIG_USB_HOST_CONTROL_TRANSFER_MAX_SIZE=1024

CONFIG_LOG_DEFAULT_LEVEL_WARN=y
CONFIG_LOG_MAXIMUM_EQUALS_DEFAULT=y

# CONFIG_LCD_RGB_RESTART_IN_VSYNC is not set
CONFIG_COMPILER_OPTIMIZATION_ASSERTIONS_SILENT=y

# Common Mozilla roots keep verified HTTPS within the existing A/B OS slot.
CONFIG_MBEDTLS_CERTIFICATE_BUNDLE_DEFAULT_CMN=y

CONFIG_SPIRAM_TRY_ALLOCATE_WIFI_LWIP=y

CONFIG_BT_ALLOCATION_FROM_SPIRAM_FIRST=y

CONFIG_SPIRAM_MALLOC_ALWAYSINTERNAL=1024

CONFIG_SPIRAM_MALLOC_RESERVE_INTERNAL=65536

# CONFIG_BT_BLE_42_DTM_TEST_EN is not set

# CONFIG_BT_BLE_42_ADV_EN is not set

CONFIG_SPIRAM_XIP_FROM_PSRAM=y

CONFIG_SPIRAM_FETCH_INSTRUCTIONS=y

CONFIG_SPIRAM_RODATA=y

CONFIG_LCD_RGB_ISR_IRAM_SAFE=y
```
